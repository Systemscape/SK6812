## examples/esp32c3_old/sdkconfig.defaults
```kconfig
### IMPORTANT: Run `cargo clean` after making changes to this file ###

# Increase stack size to accommodate all the variables needed for the display... # was 7000
CONFIG_ESP_MAIN_TASK_STACK_SIZE=30000

CONFIG_ESP_SYSTEM_EVENT_TASK_STACK_SIZE=4096

# Disable IDLE task watchdog timer
CONFIG_ESP_TASK_WDT_CHECK_IDLE_TASK_CPU0=n

# Configure logging
CONFIG_LOG_DEFAULT_LEVEL_VERBOSE=y
CONFIG_LOG_DEFAULT_LEVEL=5
CONFIG_LOG_MAXIMUM_EQUALS_DEFAULT=y
CONFIG_LOG_MAXIMUM_LEVEL=5
CONFIG_LOG_COLORS=y

# Workaround for https://github.com/espressif/esp-idf/issues/7631
#CONFIG_MBEDTLS_CERTIFICATE_BUNDLE=n
#CONFIG_MBEDTLS_CERTIFICATE_BUNDLE_DEFAULT_FULL=n

CONFIG_MBEDTLS_CERTIFICATE_BUNDLE=y
CONFIG_MBEDTLS_CERTIFICATE_BUNDLE_DEFAULT_FULL=y
CONFIG_ESP_HTTP_CLIENT_ENABLE_HTTPS=y
CONFIG_ESP_HTTP_CLIENT_ENABLE_DIGEST_AUTH=y

# Enable USB debugging on C3U
CONFIG_ESP_CONSOLE_UART=ESP_CONSOLE_USB_SERIAL_JTAG

# Autoreboot
CONFIG_ESP_SYSTEM_PANIC_PRINT_REBOOT=y

# Disable some more unneeded stuff to reduce size of binary
#CONFIG_ESP_TLS_USE_DS_PERIPHERAL=n
#CONFIG_ESP_HTTP_CLIENT_ENABLE_HTTPS=n
#CONFIG_ESP_HTTP_CLIENT_ENABLE_DIGEST_AUTH=n
CONFIG_ESP_INT_WDT=n
CONFIG_ESP_TASK_WDT=n
CONFIG_MQTT_PROTOCOL_311=n
CONFIG_MQTT_TRANSPORT_SSL=n
CONFIG_MQTT_TRANSPORT_WEBSOCKET=n
#CONFIG_OPENSSL_ERROR_STACK=n
CONFIG_VFS_SUPPORT_IO=n
CONFIG_WPA_MBEDTLS_CRYPTO=n
```
